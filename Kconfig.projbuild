## Kconfig.projbuild
```kconfig
menu "espcpputils settings"

choice ESPCPPUTILS_LOG_LOCAL_LEVEL
    bool "espcpputils log verbosity"
    default ESPCPPUTILS_LOG_LOCAL_LEVEL_INFO
    help
        Specify how much output to compile into the binary.
        You can set lower verbosity level at runtime using
        esp_log_level_set function.

        Note that this setting limits which log statements
        are compiled into the program in go-e sources. So
        setting this to, say, "Warning" would mean that
        changing log level to "Debug" at runtime will not
        be possible.

    config ESPCPPUTILS_LOG_LOCAL_LEVEL_NONE
        bool "No output"
    config ESPCPPUTILS_LOG_LOCAL_LEVEL_ERROR
        bool "Error"
    config ESPCPPUTILS_LOG_LOCAL_LEVEL_WARN
        bool "Warning"
    config ESPCPPUTILS_LOG_LOCAL_LEVEL_INFO
        bool "Info"
    config ESPCPPUTILS_LOG_LOCAL_LEVEL_DEBUG
        bool "Debug"
    config ESPCPPUTILS_LOG_LOCAL_LEVEL_VERBOSE
        bool "Verbose"
endchoice

config ESPCPPUTILS_LOG_LOCAL_LEVEL
    int
    default 0 if ESPCPPUTILS_LOG_LOCAL_LEVEL_NONE
    default 1 if ESPCPPUTILS_LOG_LOCAL_LEVEL_ERROR
    default 2 if ESPCPPUTILS_LOG_LOCAL_LEVEL_WARN
    default 3 if ESPCPPUTILS_LOG_LOCAL_LEVEL_INFO
    default 4 if ESPCPPUTILS_LOG_LOCAL_LEVEL_DEBUG
    default 5 if ESPCPPUTILS_LOG_LOCAL_LEVEL_VERBOSE

endmenu
```
